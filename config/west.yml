## config/west.yml
```yaml
manifest:
  remotes:
    - name: zmkfirmware
      url-base: https://github.com/zmkfirmware
    - name: zmk-smart-toggle
      url-base: https://github.com/caksoylar/zmk-smart-toggle.git  
    # Additional modules containing boards/shields/custom code can be listed here as well
    # See https://docs.zephyrproject.org/3.2.0/develop/west/manifest.html#projects
  projects:
    - name: zmk
      remote: zmkfirmware
      revision: main
      import: app/west.yml
    - name: zmk-smart-toggle
      remote: zmk-smart-toggle
      revision: main
  self:
    path: config
```
